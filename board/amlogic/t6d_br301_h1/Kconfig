## board/amlogic/t6d_br301_h1/Kconfig
```kconfig
if TARGET_T6D_BR301_H1

config SYS_SOC
	default "t6d"

config SYS_BOARD
	default "t6d_br301_h1"

config SYS_CONFIG_NAME
	default "t6d_br301_h1"

config DTB_BIND_KERNEL
    bool "load dtb from boot part but not flash rsv"
    default n

config BL30_SELECT
    string "t6d BL30 board config"
        default "t6d_br301"

config CMD_PLLTEST
        bool "support plltest command"
        default n
        help
            support plltest command

config AML_REBOOT
        bool "reboot cmd"
        default y
        help
            support uboot reboot cmd
endif
```

## board/amlogic/t6x_bu301/Kconfig
```kconfig
if TARGET_T6X_BU301

config SYS_SOC
	default "t6x"

config SYS_BOARD
	default "t6x_bu301"

config SYS_CONFIG_NAME
	default "t6x_bu301"

config DTB_BIND_KERNEL
    bool "load dtb from boot part but not flash rsv"
    default n

config BL30_SELECT
	string "t6X BL30 board config"
		default "t6x_bu301"

config CMD_PLLTEST
        bool "support plltest command"
        default n
		help
			support plltest command

config AML_REBOOT
		bool "reboot cmd"
		default y
		help
			support uboot reboot cmd
endif
```

## board/amlogic/t6x_bu309/Kconfig
```kconfig
if TARGET_T6X_BU309

config SYS_SOC
	default "t6x"

config SYS_BOARD
	default "t6x_bu309"

config SYS_CONFIG_NAME
	default "t6x_bu309"

config DTB_BIND_KERNEL
    bool "load dtb from boot part but not flash rsv"
    default n

config BL30_SELECT
	string "t6x BL30 board config"
		default "t6x_bu309"

config CMD_PLLTEST
        bool "support plltest command"
        default n
		help
			support plltest command

config AML_REBOOT
		bool "reboot cmd"
		default y
		help
			support uboot reboot cmd
endif
```

## drivers/amlogic/i2c/Kconfig
```kconfig
#
#Amlogic I2C control drivers
#

config SYS_I2C_MESON
	bool "Amlogic Meson SoC I2C driver"
	default n
	help
	  Say Y here if you want to use the Meson I2C control.

config SYS_I2C_MESON_T6W
	bool "Amlogic Meson T6W SoC I2C driver"
	default n
	help
	  Say Y here if you want to use the Meson I2C control.
```

## drivers/video/meson/Kconfig
```kconfig
# SPDX-License-Identifier: GPL-2.0+
#
# Copyright (C) 2018 BayLibre, SAS
#
# Author: Neil Armstrong <narmstrong@baylibre.com>

config VIDEO_MESON
	bool "Enable Amlogic Meson video support"
	depends on VIDEO
	select DISPLAY
	help
	  Enable Amlogic Meson Video Processing Unit video support.

config VIDEO_MESON_S7D
	bool "Amlogic S7D boot display on HDMI"
	depends on VIDEO && AML_HDMITX21 && AML_OSD && AML_VOUT && AML_VPP
	help
	  Show a 1920x1080 frame buffer on OSD1 of the S7D VPU, scaled to
	  the HDMI mode that the sink's EDID gives as the Linux DRM core
	  would choose it. The frame buffer is the memory-region of the
	  device tree node, so that the kernel can take it over.
```
